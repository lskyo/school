/****************************************************************************
* 文 件 名：main.c
* 功    能：使用硬件I2C对E2PROM进行操作，利用中断方式操作。
* 说    明：将跳线器JP22短接，JP20断开。
****************************************************************************/
#include  "config.h" 
#define   CAT1025   0xA0            // 定义器件地址
#define	  BEEPCON	1<<7		    // P0.7控制BEEP

/****************************************************************************
* 名    称：I2C_Init()
* 功    能：主模式I2C初始化，包括初始化其中断为向量IRQ中断。
* 入口参数：fi2c		初始化I2C总线速率，最大值为400K
* 出口参数：无
****************************************************************************/
void  I2C_Init(uint32 fi2c)
{  
    if(fi2c>400000) fi2c = 400000;

    PINSEL0 = (PINSEL0&0xFFFFFF0F) | 0x50; 	// 设置I2C控制口有效

    I2SCLH = (Fpclk/fi2c + 1) / 2;			// 设置I2C时钟为fi2c
    I2SCLL = (Fpclk/fi2c) / 2;
    I2CONCLR = 0x2C;
    I2CONSET = 0x40;						// 使能主I2C
   
    /* 设置I2C中断允许 */
    VICIntSelect = 0x00000000;				// 设置所有通道为IRQ中断
    VICVectCntl0 = 0x29;					// I2C通道分配到IRQ slot 0，即优先级最高
    VICVectAddr0 = (int)IRQ_I2C;	    	// 设置I2C中断向量地址	
    VICIntEnable = 0x0200;           		// 使能I2C中断 
}

/****************************************************************************
* 名    称：DelayNS()
* 功    能：长软件延时
* 入口参数：dly		延时参数，值越大，延时越久
* 出口参数：无
****************************************************************************/
void  DelayNS(uint32  dly)
{   uint32  i;

    for(; dly>0; dly--) 
    {
        for(i=0; i<50000; i++);
    }
}
	
/****************************************************************************
* 名    称：WrEepromErr()
* 功    能：读写EEPRM出错蜂鸣报警。
* 入口参数：无
* 出口参数：无
****************************************************************************/	
void  WrEepromErr(void)	
{  
    while(1)
    {  
        IO0SET = BEEPCON;
        DelayNS(1);
        IO0CLR = BEEPCON;
        DelayNS(1);
    }
}
			
/****************************************************************************
* 名    称：main()
* 功    能：向E2PROM写入10字节数据，然后读出判断是否正确写入。
* 说    明：在CONFIG.H文件中包含I2CINT.H。
****************************************************************************/
int  main(void)
{   uint8  i;
    uint8  data_buf[30];
    
    IRQEnable();

    PINSEL0 = 0x00000000;			
    PINSEL1 = 0x00000000;		
    IO0DIR = BEEPCON;
    IO0SET = BEEPCON;

   
    I2C_Init(30000);                      		// I2C初始化
   
   
   
    for(i=0; i<10; i++) 
    {
        data_buf[i] = i+'0';
    }
    ISendStr(CAT1025, 0x00, data_buf, 10);	    // 在0x00地址处写入10字节数据
    DelayNS(1);  
    
    
     	
    for(i=0; i<10; i++) data_buf[i] = 0;        // 等待写周期结束  
    IRcvStr(CAT1025, 0x00, data_buf, 10);		// 在0x00地址处读出10字节数据
  
    /* 校验读出的数据，若不正确则路灯闪烁 */
    for(i=0; i<10; i++)
    {  
        if(data_buf[i]!=(i+'0')) 
        {
            WrEepromErr();
        }
    }

    IO0CLR = BEEPCON;
    DelayNS(100);
    IO0SET = BEEPCON;
   
   
    while(1);
    return(0);					
}

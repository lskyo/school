/****************************************************************************
* 文 件 名：main.c
* 功    能：向串口发送数据。
* 说    明：使用外部11.0592MHz晶振，根据CONFIG.H文件配置，Fpclk=11.0592MHz；
*           通讯波特率115200，8位数据位，1位停止位，无奇偶校验。
****************************************************************************/
#include  "config.h"

#define  UART_BPS	9600			// 定义通讯波特率
uint8 const  SEND_STRING[] = "Hello World!\r\n";


/****************************************************************************
* 名    称：DelayNS()
* 功    能：长软件延时
* 入口参数：dly		延时参数，值越大，延时越久
* 出口参数：无
****************************************************************************/
void  DelayNS(uint32  dly)
{   uint32  i;
    
    for(; dly>0; dly--) 
    {
        for(i=0; i<5000; i++);
    }

}

/****************************************************************************
* 名    称：UART0_Ini()
* 功    能：初始化串口0。设置为8位数据位，1位停止位，无奇偶校验，波特率为115200
* 入口参数：无
* 出口参数：无
****************************************************************************/
void  UART0_Init(void)
{   uint16 Fdiv;

    U0LCR = 0x83;						// DLAB = 1，可设置波特率
    Fdiv = (Fpclk / 16) / UART_BPS;		// 设置波特率
    U0DLM = Fdiv / 256;							
    U0DLL = Fdiv % 256;						
    U0LCR = 0x03;
}				

/****************************************************************************
* 名    称：UART0_SendByte()
* 功    能：向串口发送字节数据，并等待发送完毕。
* 入口参数：data		要发送的数据
* 出口参数：无
****************************************************************************/
void  UART0_SendByte(uint8 data)
{  
    U0THR = data;				    	// 发送数据
    while( (U0LSR&0x40)==0 );	    	// 等待数据发送完毕
}

/****************************************************************************
* 名    称：UART0_SendStr()
* 功    能：向串口发送一字符串
* 入口参数：str		要发送的字符串的指针
* 出口参数：无
****************************************************************************/
void  UART0_SendStr(uint8 const *str)
{  
    while(1)
    {  
        if( *str == '\0' ) break;
        UART0_SendByte(*str++);	    	// 发送数据
    }
}

/****************************************************************************
* 名    称：main()
* 功    能：向串口UART0发送字符串"Hello World!"
****************************************************************************/
int  main(void)
{  
    PINSEL0 = 0x00000005;		    // 设置I/O连接到UART0
    UART0_Init();
    
    while(1)	
    {  
        UART0_SendStr(SEND_STRING);
        DelayNS(100);
    }
    
    return(0);
}

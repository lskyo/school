/****************************************Copyright (c)**************************************************
**                              UESTC  zhongshan institute
**                                    
**                                 http://www.zsc.edu.cn
**
**--------------File Info-------------------------------------------------------------------------------
** File name:			main.c
** Last modified Date:  2012-11-16
** Last Version:		1.0
** Descriptions:		The main() function example template
**
**------------------------------------------------------------------------------------------------------
** Created by:			DengCJ
** Created date:		2012-11-16
** Version:				1.0
** Descriptions:		The original version
**
**------------------------------------------------------------------------------------------------------
** Modified by:
** Modified date:
** Version:
** Descriptions:
**
********************************************************************************************************/
#include "config.h"

const float NOTE[21]={
261.63  ,293.67   ,329.63  ,349.23 ,391.99  ,493.88 ,440  ,                 
523.25  ,587.33   ,659.25  ,698.46 ,783.99  ,880    ,987.76 ,                     
1046.5 ,1174.66  ,1318.51 ,1396.92,1567.98 ,1760   ,1975.5 };
const int  music_book[]={8,9,10,8,  8,9,10,8,  10,11,12,  10,11,12, 12,13,12,11,10,8,   12,13,12,11,10,8,  8,5,8,   8,5,8  }; 
const int  music_book1[]={8,5,10,8,  8,4,10,8,  10,4,8,12,  10,11,12, 12,13,12,3,10,8,   12,13,8,11,10,8,  8,5,8,   8,5,8  };
const int  music_book2[]={0,0,0,3,  3,3,6,6,  6,9,9,9,  12,12,12, 15,15,15,18,18,18,   21,21,21};
/********************************************************************************************************
**函数名称:Delay
**功能描述:软件延时函数
********************************************************************************************************/
void Delay(uint8 dly)
{   uint32 i;

    for(;dly>0;dly--)
       for(i=0;i<0x2fff;i++);
 }
 
 /********************************************************************************************************
**函数名称:main()
**函数功能:PWM音乐输出实验
**调试说明:需要将music.h包含进来
********************************************************************************************************/





int  main(void){  
         int i=0;
            PINSEL0  = 0x02 << 14;		         // P0.7 ==> PWM2
            PWMPR    = 0;		                  // Freq = Fpclk
            PWMMCR   = 0x02;
            PWMMR0   = Fpclk / 2000;
            PWMMR2   = PWMMR0;	    	         // 50%
            PWMPCR   = 0x0400;			         // Enable PWM2 Output, single edge PWM
            PWMLER   = 0x05;			
            PWMTCR   = 0x02;                    // Restart PWMTC
            PWMTCR   = 0x09;                    // Start PWM output
    while(1)    {
          PWMTC=0;
          PWMMR0 =Fpclk/NOTE[ music_book2[i]];          // 设置PWM周期
          PWMMR2 =(Fpclk/NOTE[ music_book2[i] ])*0.40;// 占空比为%90  
          PWMLER = 0x05;			             // PWMMR0、PWMMR2锁存 
          Delay(3);
         i++;
          i=i%24;
       }
    return(0);
}
